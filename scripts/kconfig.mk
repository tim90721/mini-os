## src/Config.in
```kconfig
choice
	prompt "Target Type"
	default TARGET_KERNEL

	config TARGET_KERNEL
		bool "Kernel"
	config TARGET_SANDBOX
		bool "Sandbox"

endchoice

source "arch/Config.in"
source "drivers/Config.in"
source "kernel/Config.in"

config CROSS_COMPILE
	string "Target compile tool chain"
	default "riscv64-unknown-elf-" if ARCH_RISC_V
	default "aarch64-none-elf-" if ARCH_ARM64

config QEMU
	string "Target qemu"
	default "qemu-system-riscv32" if ARCH_RISC_V
	default "qemu-system-aarch64" if ARCH_ARM64

config DEBUG_TRACE
	bool "Trace debug output"
	default n
```

## src/arch/Config.in
```kconfig
choice
	prompt "Target Architecture"
	default ARCH_RISC_V

	config ARCH_RISC_V
		bool "RISV-V"
	config ARCH_ARM64
		bool "ARM64"

endchoice

config ARCH
	string
	default "risc-v" if ARCH_RISC_V
	default "arm64" if ARCH_ARM64

source "arch/risc-v/Config.in"
source "arch/arm64/Config.in"
```

## src/arch/arm64/Config.in
```kconfig
config ARM64_HYPERVISOR
	bool

config ARM64_TRUSTZONE
	bool

source "arch/arm64/platform/Config.in"
source "arch/arm64/sandbox/Config.in"
```

## src/arch/arm64/platform/Config.in
```kconfig
menu "ARM64 Platform Configurations"
depends on ARCH_ARM64

choice
	prompt "ARM64 Target Platform"
	depends on ARCH_ARM64
	default PLATFORM_QEMU_ARM64_VIRT

	config PLATFORM_QEMU_ARM64_VIRT
		bool "Platform Qemu ARM64 Virt"

endchoice

config PLATFORM
	string
	default "virt" if PLATFORM_QEMU_ARM64_VIRT

source "arch/arm64/platform/virt/Config.in"

endmenu
```

## src/arch/arm64/platform/virt/Config.in
```kconfig
menu "ARM64 Virtual Platform Configurations"
depends on PLATFORM_QEMU_ARM64_VIRT

config ARM64_VIRT_HYPERVISOR
	bool "Enable Hypervisor"
	default n
	select ARM64_HYPERVISOR

config ARM64_VIRT_TRUSTZONE
	bool "Enable Trustzone"
	default n
	select ARM64_TRUSTZONE

choice
	prompt "ARM64 Virtual Platform CPU Number Configuration"
	default ARM64_VIRT_CPU_1

	config ARM64_VIRT_CPU_1
		bool "Simulate with 1 ARM64 CPU Core"
	config ARM64_VIRT_CPU_2
		bool "Simulate with 2 ARM64 CPU Cores"
	config ARM64_VIRT_CPU_4
		bool "Simulate with 4 ARM64 CPU Cores"
	config ARM64_VIRT_CPU_8
		bool "Simulate with 8 ARM64 CPU Cores"
endchoice

config ARM64_VIRT_CPU_CORES
	int
	default 1 if ARM64_VIRT_CPU_1
	default 2 if ARM64_VIRT_CPU_2
	default 4 if ARM64_VIRT_CPU_4
	default 8 if ARM64_VIRT_CPU_8

endmenu
```

## src/arch/arm64/sandbox/Config.in
```kconfig
menu "ARM64 Sandbox"
	depends on TARGET_SANDBOX

choice
	prompt "Sandbox Target"
	config LDR_STR
		bool "Load Store Practice"
	config MEMCPY_ASM
		bool "Memory Copy Assembly Practice"
	config MATH_SHIFT
		bool "Math Shift Practice"
endchoice

endmenu
```

## src/arch/risc-v/platform/Config.in
```kconfig
choice
	prompt "RISC-V Target Platform"
	depends on ARCH_RISC_V
	default PLATFORM_QEMU_RISC_V_VIRT

	config PLATFORM_QEMU_RISC_V_VIRT
		bool "Platform Qemu RISC-V Virt"

endchoice

config PLATFORM
	string
	default "virt" if PLATFORM_QEMU_RISC_V_VIRT
```

## src/drivers/Config.in
```kconfig
menu "Drivers"
depends on TARGET_KERNEL

source "drivers/uart/Config.in"
source "drivers/irqchip/Config.in"

endmenu
```

## src/drivers/irqchip/Config.in
```kconfig
config IRQCHIP
	bool "IRQ Chip Drivers"
	default y

config IRQCHIP_PLIC
	bool "IRQ Chip PLIC Driver Support"
	depends on IRQCHIP && ARCH_RISC_V

config IRQCHIP_GIC_V2
	bool "IRQ Chip GICv2 Driver Support"
	depends on IRQCHIP
```

## src/drivers/uart/Config.in
```kconfig
config UART
	bool "UART Driver"
	default y

config UART_16550A
	bool "UART 16550A Driver Support"
	depends on UART

config UART_PL011
	bool "UART PL011 Driver Support"
	depends on UART
```

## src/kernel/Config.in
```kconfig
menu "Kernel"
depends on TARGET_KERNEL

config TIMER_INTERVAL
	int "Timer HZ"
	default 10000

endmenu
```
